/*
 * HAND-MAINTAINED — DO NOT regenerate via `make setup` / splat.
 *
 * The rodata-cleanup project (2026-06-09) re-attributed every
 * asm/data/*.rodata*.s block's bytes to C source files. Regenerating this
 * script via splat would re-add `build/asm/data/*.rodata*.o(.rodata)` lines
 * that no longer have backing .s files (link error) AND would conflict with
 * the const declarations now living in src/*.c (multiple-definition).
 *
 * See the long warning block at the top of splat.yaml for recovery
 * procedure if splat re-runs accidentally.
 *
 * Verification: `grep -c 'asm/data/.*\.rodata.*\.o(\.rodata)' bb2.ld`
 * should be 0.
 */
SECTIONS
{
    __romPos = 0;
    _gp = 0x800A30CC;
    header_ROM_START = __romPos;
    header_VRAM = ADDR(.header);
    .header : AT(header_ROM_START) SUBALIGN(2)
    {
        FILL(0x00000000);
        header_DATA_START = .;
        build/asm/header.o(.data);
        header_DATA_END = .;
        header_DATA_SIZE = ABSOLUTE(header_DATA_END - header_DATA_START);
    }
    __romPos += SIZEOF(.header);
    header_ROM_END = __romPos;
    header_VRAM_END = .;

    main_ROM_START = __romPos;
    main_VRAM = ADDR(.main);
    .main 0x80010000 : AT(main_ROM_START) SUBALIGN(2)
    {
        FILL(0x00000000);
        main_RODATA_START = .;
        build/src/main/6CF8.o(.rodata);
        build/src/main/87A0.o(.rodata);
        build/src/main/9F9C.o(.rodata);
        build/src/main/175A4.o(.rodata);
        build/src/main/17AFC.o(.rodata);
        build/src/main/24BF0.o(.rodata);
        build/src/main/d_1068.o(.rodata);
        build/src/main/24F08.o(.rodata);
        build/src/main/25788.o(.rodata);
        build/src/main/25C38.o(.rodata);
        build/src/main/26730.o(.rodata);
        build/src/main/267A8.o(.rodata);
        build/src/main/26940.o(.rodata);
        build/src/main/cdrom.o(.rodata);
        build/src/main/memcard.o(.rodata);
        build/src/main/28514.o(.rodata);
        build/src/main/28708.o(.rodata);
        build/src/main/2B344.o(.rodata);
        build/src/main/309CC.o(.rodata);
        build/src/main/31548.o(.rodata);
        build/src/main/31CFC.o(.rodata);
        build/src/main/31D3C.o(.rodata);
        build/src/main/32D04.o(.rodata);
        build/src/main/35000.o(.rodata);
        build/src/main/d_15EC.o(.rodata);
        build/src/main/368E4.o(.rodata);
        build/src/main/d_5BF0.o(.rodata);
        build/src/main/3AB48.o(.rodata);
        build/src/main/51268.o(.rodata);
        build/src/main/5ED34.o(.rodata);
        build/src/main/63D2C.o(.rodata);
        build/src/main/64FD8.o(.rodata);
        build/src/main/psxsdk/libc2/prnt.o(.rodata);
        build/src/main/psxsdk/libc2/sprintf.o(.rodata);
        build/src/main/psxsdk/libgpu/prim.o(.rodata);
        build/src/main/psxsdk/libgpu/sys.o(.rodata);
        build/src/main/psxsdk/libcd/event.o(.rodata);
        build/src/main/psxsdk/libcd/sys.o(.rodata);
        build/src/main/psxsdk/libcd/bios.o(.rodata);
        build/src/main/psxsdk/libc2/puts.o(.rodata);
        build/src/main/psxsdk/libcd/cdread.o(.rodata);
        build/src/main/psxsdk/libetc/vsync.o(.rodata);
        build/src/main/psxsdk/libetc/intr.o(.rodata);
        build/src/main/psxsdk/libetc/intr_dma.o(.rodata);
        build/src/main/psxsdk/libsnd/sstick.o(.rodata);
        build/src/main/psxsdk/libspu/spu.o(.rodata);
        build/src/main/psxsdk/libspu/s_sca.o(.rodata);
        build/src/main/psxsdk/libspu/7BC88.o(.rodata);
        build/src/main/psxsdk/libcomb/comb.o(.rodata);
        main_RODATA_END = .;
        main_RODATA_SIZE = ABSOLUTE(main_RODATA_END - main_RODATA_START);
        main_TEXT_START = .;
        build/src/main/6CF8.o(.text);
        build/src/main/87A0.o(.text);
        build/src/main/9F9C.o(.text);
        build/src/main/175A4.o(.text);
        build/src/main/17AFC.o(.text);
        build/src/main/24BF0.o(.text);
        build/src/main/24F08.o(.text);
        build/src/main/25788.o(.text);
        build/src/main/25C38.o(.text);
        build/src/main/26730.o(.text);
        build/src/main/267A8.o(.text);
        build/src/main/26940.o(.text);
        build/src/main/cdrom.o(.text);
        build/src/main/memcard.o(.text);
        build/src/main/28514.o(.text);
        build/src/main/28708.o(.text);
        build/src/main/2B344.o(.text);
        build/src/main/309CC.o(.text);
        build/src/main/31548.o(.text);
        build/src/main/31CFC.o(.text);
        build/src/main/31D3C.o(.text);
        build/src/main/32D04.o(.text);
        build/src/main/35000.o(.text);
        build/src/main/368E4.o(.text);
        build/src/main/3AB48.o(.text);
        build/src/main/51268.o(.text);
        build/src/main/5ED34.o(.text);
        build/src/main/63D2C.o(.text);
        build/src/main/64FD8.o(.text);
        build/src/main/psxsdk/libapi/c67.o(.text);
        build/src/main/psxsdk/libapi/c112.o(.text);
        build/src/main/psxsdk/libapi/c159.o(.text);
        build/src/main/psxsdk/libapi/a08.o(.text);
        build/src/main/psxsdk/libapi/a09.o(.text);
        build/src/main/psxsdk/libapi/a11.o(.text);
        build/src/main/psxsdk/libapi/a12.o(.text);
        build/src/main/psxsdk/libapi/a36.o(.text);
        build/src/main/psxsdk/libapi/a37.o(.text);
        build/src/main/psxsdk/libapi/a39.o(.text);
        build/src/main/psxsdk/libapi/a50.o(.text);
        build/src/main/psxsdk/libapi/a52.o(.text);
        build/src/main/psxsdk/libapi/a53.o(.text);
        build/src/main/psxsdk/libapi/a54.o(.text);
        build/src/main/psxsdk/libapi/a65.o(.text);
        build/src/main/psxsdk/libapi/a66.o(.text);
        build/src/main/psxsdk/libapi/a67.o(.text);
        build/src/main/psxsdk/libapi/a91.o(.text);
        build/src/main/psxsdk/libapi/counter.o(.text);
        build/src/main/psxsdk/libapi/pad.o(.text);
        build/src/main/psxsdk/libapi/a18.o(.text);
        build/src/main/psxsdk/libapi/a19.o(.text);
        build/src/main/psxsdk/libapi/a20.o(.text);
        build/src/main/psxsdk/libapi/a21.o(.text);
        build/src/main/psxsdk/libapi/l02.o(.text);
        build/src/main/psxsdk/libapi/l03.o(.text);
        build/src/main/psxsdk/libapi/patch.o(.text);
        build/src/main/psxsdk/libapi/c68.o(.text);
        build/src/main/psxsdk/libapi/sendpad.o(.text);
        build/src/main/psxsdk/libapi/chclrpad.o(.text);
        build/src/main/psxsdk/libc2/memcpy.o(.text);
        build/src/main/psxsdk/libc2/rand.o(.text);
        build/src/main/psxsdk/libc2/strcpy.o(.text);
        build/src/main/psxsdk/libc2/strlen.o(.text);
        build/src/main/psxsdk/libc2/printf.o(.text);
        build/src/main/psxsdk/libc2/prnt.o(.text);
        build/src/main/psxsdk/libc2/ctype.o(.text);
        build/src/main/psxsdk/libc2/memchr.o(.text);
        build/src/main/psxsdk/libc2/putchar.o(.text);
        build/src/main/psxsdk/libc2/sprintf.o(.text);
        build/src/main/psxsdk/libc2/memmove.o(.text);
        build/src/main/psxsdk/libcard/c171.o(.text);
        build/src/main/psxsdk/libcard/c172.o(.text);
        build/src/main/psxsdk/libcard/card.o(.text);
        build/src/main/psxsdk/libcard/a78.o(.text);
        build/src/main/psxsdk/libcard/a80.o(.text);
        build/src/main/psxsdk/libcard/init.o(.text);
        build/src/main/psxsdk/libcard/a74.o(.text);
        build/src/main/psxsdk/libcard/a75.o(.text);
        build/src/main/psxsdk/libcard/a76.o(.text);
        build/src/main/psxsdk/libcard/end.o(.text);
        build/src/main/psxsdk/libgpu/ext.o(.text);
        build/src/main/psxsdk/libgpu/prim.o(.text);
        build/src/main/psxsdk/libgpu/sys.o(.text);
        build/src/main/psxsdk/libapi/c73.o(.text);
        build/src/main/psxsdk/libgte/geo_00.o(.text);
        build/src/main/psxsdk/libgte/geo_01.o(.text);
        build/src/main/psxsdk/libgte/msc00.o(.text);
        build/src/main/psxsdk/libgte/msc01.o(.text);
        build/src/main/psxsdk/libgte/msc06.o(.text);
        build/src/main/psxsdk/libgte/msc09.o(.text);
        build/src/main/psxsdk/libgte/mtx_000.o(.text);
        build/src/main/psxsdk/libgte/mtx_003.o(.text);
        build/src/main/psxsdk/libgte/mtx_004.o(.text);
        build/src/main/psxsdk/libgte/mtx_005.o(.text);
        build/src/main/psxsdk/libgte/mtx_00a.o(.text);
        build/src/main/psxsdk/libgte/mtx_01.o(.text);
        build/src/main/psxsdk/libgte/mtx_03.o(.text);
        build/src/main/psxsdk/libgte/mtx_04.o(.text);
        build/src/main/psxsdk/libgte/mtx_05.o(.text);
        build/src/main/psxsdk/libgte/mtx_08.o(.text);
        build/src/main/psxsdk/libgte/mtx_09.o(.text);
        build/src/main/psxsdk/libgte/mtx_11.o(.text);
        build/src/main/psxsdk/libgte/mtx_12.o(.text);
        build/src/main/psxsdk/libgte/reg04.o(.text);
        build/src/main/psxsdk/libgte/reg09.o(.text);
        build/src/main/psxsdk/libgte/reg10.o(.text);
        build/src/main/psxsdk/libgte/reg11.o(.text);
        build/src/main/psxsdk/libgte/reg12.o(.text);
        build/src/main/psxsdk/libgte/reg13.o(.text);
        build/src/main/psxsdk/libgte/smp_00.o(.text);
        build/src/main/psxsdk/libgte/smp_02.o(.text);
        build/src/main/psxsdk/libgte/smp_03.o(.text);
        build/src/main/psxsdk/libgte/smp_04.o(.text);
        build/src/main/psxsdk/libgte/cmb_00.o(.text);
        build/src/main/psxsdk/libgte/fgo_01.o(.text);
        build/src/main/psxsdk/libgte/fgo_03.o(.text);
        build/src/main/psxsdk/libgte/fgo_04.o(.text);
        build/src/main/psxsdk/libgte/fgo_05.o(.text);
        build/src/main/psxsdk/libgte/fgo_06.o(.text);
        build/src/main/psxsdk/libgte/ratan.o(.text);
        build/src/main/psxsdk/libgte/patchgte.o(.text);
        build/src/main/psxsdk/libcd/event.o(.text);
        build/src/main/psxsdk/libapi/a07.o(.text);
        build/src/main/psxsdk/libcd/sys.o(.text);
        build/src/main/psxsdk/libcd/bios.o(.text);
        build/src/main/psxsdk/libc2/puts.o(.text);
        build/src/main/psxsdk/libcd/cdread.o(.text);
        build/src/main/psxsdk/libetc/vsync.o(.text);
        build/src/main/psxsdk/libapi/l10.o(.text);
        build/src/main/psxsdk/libetc/intr.o(.text);
        build/src/main/psxsdk/libapi/c114.o(.text);
        build/src/main/psxsdk/libapi/a23.o(.text);
        build/src/main/psxsdk/libapi/a24.o(.text);
        build/src/main/psxsdk/libapi/a25.o(.text);
        build/src/main/psxsdk/libc2/setjmp.o(.text);
        build/src/main/psxsdk/libetc/intr_vb.o(.text);
        build/src/main/psxsdk/libetc/intr_dma.o(.text);
        build/src/main/psxsdk/libetc/vmode.o(.text);
        build/src/main/psxsdk/libsn/73E98.o(.text);
        build/src/main/psxsdk/libapi/c57.o(.text);
        build/src/main/psxsdk/libsn/7407C.o(.text);
        build/src/main/psxsdk/libsnd/ssend.o(.text);
        build/src/main/psxsdk/libsnd/ssinit_c.o(.text);
        build/src/main/psxsdk/libsnd/ssinit.o(.text);
        build/src/main/psxsdk/libsnd/ssquit.o(.text);
        build/src/main/psxsdk/libsnd/scssattr.o(.text);
        build/src/main/psxsdk/libsnd/scsmvol.o(.text);
        build/src/main/psxsdk/libsnd/ssstart.o(.text);
        build/src/main/psxsdk/libsnd/sscall.o(.text);
        build/src/main/psxsdk/libsnd/cres.o(.text);
        build/src/main/psxsdk/libsnd/pause.o(.text);
        build/src/main/psxsdk/libsnd/play.o(.text);
        build/src/main/psxsdk/libsnd/75174.o(.text);
        build/src/main/psxsdk/libsnd/miditime.o(.text);
        build/src/main/psxsdk/libsnd/next.o(.text);
        build/src/main/psxsdk/libsnd/replay.o(.text);
        build/src/main/psxsdk/libsnd/stop.o(.text);
        build/src/main/psxsdk/libsnd/scssvol.o(.text);
        build/src/main/psxsdk/libsnd/sstick.o(.text);
        build/src/main/psxsdk/libsnd/tempo.o(.text);
        build/src/main/psxsdk/libsnd/760D0.o(.text);
        build/src/main/psxsdk/libsnd/ut_gvba.o(.text);
        build/src/main/psxsdk/libsnd/76240.o(.text);
        build/src/main/psxsdk/libsnd/ut_rdep.o(.text);
        build/src/main/psxsdk/libsnd/ut_rev.o(.text);
        build/src/main/psxsdk/libsnd/ut_roff.o(.text);
        build/src/main/psxsdk/libsnd/ut_ron.o(.text);
        build/src/main/psxsdk/libsnd/ut_vvol.o(.text);
        build/src/main/psxsdk/libsnd/vm_doff.o(.text);
        build/src/main/psxsdk/libsnd/vm_f.o(.text);
        build/src/main/psxsdk/libsnd/vm_n2p.o(.text);
        build/src/main/psxsdk/libsnd/774F8.o(.text);
        build/src/main/psxsdk/libsnd/vm_vsu.o(.text);
        build/src/main/psxsdk/libsnd/vs_auto.o(.text);
        build/src/main/psxsdk/libsnd/vs_mono.o(.text);
        build/src/main/psxsdk/libsnd/vs_srv.o(.text);
        build/src/main/psxsdk/libsnd/vs_vab.o(.text);
        build/src/main/psxsdk/libsnd/vs_vfb.o(.text);
        build/src/main/psxsdk/libsnd/vs_vh.o(.text);
        build/src/main/psxsdk/libsnd/vs_vtb.o(.text);
        build/src/main/psxsdk/libsnd/vs_vtc.o(.text);
        build/src/main/psxsdk/libspu/s_i.o(.text);
        build/src/main/psxsdk/libspu/s_ini.o(.text);
        build/src/main/psxsdk/libspu/spu.o(.text);
        build/src/main/psxsdk/libspu/s_dcb.o(.text);
        build/src/main/psxsdk/libspu/s_q.o(.text);
        build/src/main/psxsdk/libapi/a13.o(.text);
        build/src/main/psxsdk/libspu/s_m_init.o(.text);
        build/src/main/psxsdk/libspu/s_m_m.o(.text);
        build/src/main/psxsdk/libspu/s_m_int.o(.text);
        build/src/main/psxsdk/libspu/s_m_f.o(.text);
        build/src/main/psxsdk/libspu/s_snv.o(.text);
        build/src/main/psxsdk/libspu/7A248.o(.text);
        build/src/main/psxsdk/libspu/s_snc.o(.text);
        build/src/main/psxsdk/libspu/s_sr.o(.text);
        build/src/main/psxsdk/libspu/s_m_util.o(.text);
        build/src/main/psxsdk/libspu/s_srmp.o(.text);
        build/src/main/psxsdk/libspu/s_sra.o(.text);
        build/src/main/psxsdk/libspu/s_srv.o(.text);
        build/src/main/psxsdk/libspu/s_crwa.o(.text);
        build/src/main/psxsdk/libapi/a10.o(.text);
        build/src/main/psxsdk/libspu/s_sk.o(.text);
        build/src/main/psxsdk/libspu/s_gks.o(.text);
        build/src/main/psxsdk/libspu/s_r.o(.text);
        build/src/main/psxsdk/libspu/s_w.o(.text);
        build/src/main/psxsdk/libspu/s_stsa.o(.text);
        build/src/main/psxsdk/libspu/s_stm.o(.text);
        build/src/main/psxsdk/libspu/s_itc.o(.text);
        build/src/main/psxsdk/libspu/s_it.o(.text);
        build/src/main/psxsdk/libspu/s_sca.o(.text);
        build/src/main/psxsdk/libspu/sr_gaks.o(.text);
        build/src/main/psxsdk/libspu/7BC88.o(.text);
        build/src/main/psxsdk/libspu/s_n2p.o(.text);
        build/src/main/psxsdk/libspu/s_gvv.o(.text);
        build/src/main/psxsdk/libspu/s_gvex.o(.text);
        build/src/main/psxsdk/libcomb/comb.o(.text);
        build/src/main/psxsdk/libapi/a71.o(.text);
        build/src/main/psxsdk/libapi/a72.o(.text);
        build/src/main/d_7D870.o(.text);
        main_TEXT_END = .;
        main_TEXT_SIZE = ABSOLUTE(main_TEXT_END - main_TEXT_START);
        main_DATA_START = .;
        build/src/main/87A0.o(.data);
        build/src/main/9F9C.o(.data);
        build/src/main/175A4.o(.data);
        build/src/main/17AFC.o(.data);
        build/src/main/24BF0.o(.data);
        build/src/main/24F08.o(.data);
        build/src/main/25788.o(.data);
        build/src/main/25C38.o(.data);
        build/src/main/26730.o(.data);
        build/src/main/267A8.o(.data);
        build/src/main/26940.o(.data);
        build/src/main/cdrom.o(.data);
        build/src/main/memcard.o(.data);
        build/src/main/28514.o(.data);
        build/src/main/28708.o(.data);
        build/src/main/2B344.o(.data);
        build/src/main/309CC.o(.data);
        build/src/main/31548.o(.data);
        build/src/main/31CFC.o(.data);
        build/src/main/31D3C.o(.data);
        build/src/main/32D04.o(.data);
        build/src/main/35000.o(.data);
        build/src/main/368E4.o(.data);
        build/src/main/3AB48.o(.data);
        build/src/main/51268.o(.data);
        build/src/main/5ED34.o(.data);
        build/src/main/63D2C.o(.data);
        build/src/main/64FD8.o(.data);
        build/src/main/psxsdk/libapi/c67.o(.data);
        build/src/main/psxsdk/libapi/c112.o(.data);
        build/src/main/psxsdk/libapi/c159.o(.data);
        build/src/main/psxsdk/libapi/a08.o(.data);
        build/src/main/psxsdk/libapi/a09.o(.data);
        build/src/main/psxsdk/libapi/a11.o(.data);
        build/src/main/psxsdk/libapi/a12.o(.data);
        build/src/main/psxsdk/libapi/a36.o(.data);
        build/src/main/psxsdk/libapi/a37.o(.data);
        build/src/main/psxsdk/libapi/a39.o(.data);
        build/src/main/psxsdk/libapi/a50.o(.data);
        build/src/main/psxsdk/libapi/a52.o(.data);
        build/src/main/psxsdk/libapi/a53.o(.data);
        build/src/main/psxsdk/libapi/a54.o(.data);
        build/src/main/psxsdk/libapi/a65.o(.data);
        build/src/main/psxsdk/libapi/a66.o(.data);
        build/src/main/psxsdk/libapi/a67.o(.data);
        build/src/main/psxsdk/libapi/a91.o(.data);
        build/src/main/psxsdk/libapi/counter.o(.data);
        build/src/main/psxsdk/libapi/pad.o(.data);
        build/src/main/psxsdk/libapi/a18.o(.data);
        build/src/main/psxsdk/libapi/a19.o(.data);
        build/src/main/psxsdk/libapi/a20.o(.data);
        build/src/main/psxsdk/libapi/a21.o(.data);
        build/src/main/psxsdk/libapi/l02.o(.data);
        build/src/main/psxsdk/libapi/l03.o(.data);
        build/src/main/psxsdk/libapi/patch.o(.data);
        build/src/main/psxsdk/libapi/c68.o(.data);
        build/src/main/psxsdk/libapi/sendpad.o(.data);
        build/src/main/psxsdk/libapi/chclrpad.o(.data);
        build/src/main/psxsdk/libc2/memcpy.o(.data);
        build/src/main/psxsdk/libc2/rand.o(.data);
        build/src/main/psxsdk/libc2/strcpy.o(.data);
        build/src/main/psxsdk/libc2/strlen.o(.data);
        build/src/main/psxsdk/libc2/printf.o(.data);
        build/src/main/psxsdk/libc2/prnt.o(.data);
        build/src/main/psxsdk/libc2/ctype.o(.data);
        build/src/main/psxsdk/libc2/memchr.o(.data);
        build/src/main/psxsdk/libc2/putchar.o(.data);
        build/src/main/psxsdk/libc2/sprintf.o(.data);
        build/src/main/psxsdk/libc2/memmove.o(.data);
        build/src/main/psxsdk/libcard/c171.o(.data);
        build/src/main/psxsdk/libcard/c172.o(.data);
        build/src/main/psxsdk/libcard/card.o(.data);
        build/src/main/psxsdk/libcard/a78.o(.data);
        build/src/main/psxsdk/libcard/a80.o(.data);
        build/src/main/psxsdk/libcard/init.o(.data);
        build/src/main/psxsdk/libcard/a74.o(.data);
        build/src/main/psxsdk/libcard/a75.o(.data);
        build/src/main/psxsdk/libcard/a76.o(.data);
        build/src/main/psxsdk/libcard/end.o(.data);
        build/src/main/psxsdk/libgpu/ext.o(.data);
        build/src/main/psxsdk/libgpu/prim.o(.data);
        build/src/main/psxsdk/libgpu/sys.o(.data);
        build/src/main/psxsdk/libapi/c73.o(.data);
        build/src/main/psxsdk/libgte/geo_00.o(.data);
        build/src/main/psxsdk/libgte/geo_01.o(.data);
        build/src/main/psxsdk/libgte/msc00.o(.data);
        build/src/main/psxsdk/libgte/msc01.o(.data);
        build/src/main/psxsdk/libgte/msc06.o(.data);
        build/src/main/psxsdk/libgte/msc09.o(.data);
        build/src/main/psxsdk/libgte/mtx_000.o(.data);
        build/src/main/psxsdk/libgte/mtx_003.o(.data);
        build/src/main/psxsdk/libgte/mtx_004.o(.data);
        build/src/main/psxsdk/libgte/mtx_005.o(.data);
        build/src/main/psxsdk/libgte/mtx_00a.o(.data);
        build/src/main/psxsdk/libgte/mtx_01.o(.data);
        build/src/main/psxsdk/libgte/mtx_03.o(.data);
        build/src/main/psxsdk/libgte/mtx_04.o(.data);
        build/src/main/psxsdk/libgte/mtx_05.o(.data);
        build/src/main/psxsdk/libgte/mtx_08.o(.data);
        build/src/main/psxsdk/libgte/mtx_09.o(.data);
        build/src/main/psxsdk/libgte/mtx_11.o(.data);
        build/src/main/psxsdk/libgte/mtx_12.o(.data);
        build/src/main/psxsdk/libgte/reg04.o(.data);
        build/src/main/psxsdk/libgte/reg09.o(.data);
        build/src/main/psxsdk/libgte/reg10.o(.data);
        build/src/main/psxsdk/libgte/reg11.o(.data);
        build/src/main/psxsdk/libgte/reg12.o(.data);
        build/src/main/psxsdk/libgte/reg13.o(.data);
        build/src/main/psxsdk/libgte/smp_00.o(.data);
        build/src/main/psxsdk/libgte/smp_02.o(.data);
        build/src/main/psxsdk/libgte/smp_03.o(.data);
        build/src/main/psxsdk/libgte/smp_04.o(.data);
        build/src/main/psxsdk/libgte/cmb_00.o(.data);
        build/src/main/psxsdk/libgte/fgo_01.o(.data);
        build/src/main/psxsdk/libgte/fgo_03.o(.data);
        build/src/main/psxsdk/libgte/fgo_04.o(.data);
        build/src/main/psxsdk/libgte/fgo_05.o(.data);
        build/src/main/psxsdk/libgte/fgo_06.o(.data);
        build/src/main/psxsdk/libgte/ratan.o(.data);
        build/src/main/psxsdk/libgte/patchgte.o(.data);
        build/src/main/psxsdk/libcd/event.o(.data);
        build/asm/data/7D920.data.o(.data);
        build/src/main/psxsdk/libapi/a07.o(.data);
        build/src/main/psxsdk/libcd/sys.o(.data);
        /* libcd bios.c: Intr (static volatile CD_intr, defined in src/main/psxsdk/libcd/bios.c) at 0x800A1494 */
        build/src/main/psxsdk/libcd/bios.o(.data);
        build/src/main/psxsdk/libc2/puts.o(.data);
        build/src/main/psxsdk/libcd/cdread.o(.data);
        build/src/main/psxsdk/libetc/vsync.o(.data);
        build/src/main/psxsdk/libapi/l10.o(.data);
        build/src/main/psxsdk/libetc/intr.o(.data);
        build/src/main/psxsdk/libapi/c114.o(.data);
        build/src/main/psxsdk/libapi/a23.o(.data);
        build/src/main/psxsdk/libapi/a24.o(.data);
        build/src/main/psxsdk/libapi/a25.o(.data);
        build/src/main/psxsdk/libc2/setjmp.o(.data);
        build/src/main/psxsdk/libetc/intr_vb.o(.data);
        build/src/main/psxsdk/libetc/intr_dma.o(.data);
        build/src/main/psxsdk/libetc/vmode.o(.data);
        build/src/main/psxsdk/libsn/73E98.o(.data);
        build/src/main/psxsdk/libapi/c57.o(.data);
        build/src/main/psxsdk/libsn/7407C.o(.data);
        build/src/main/psxsdk/libsnd/ssend.o(.data);
        build/src/main/psxsdk/libsnd/ssinit_c.o(.data);
        build/src/main/psxsdk/libsnd/ssinit.o(.data);
        build/src/main/psxsdk/libsnd/ssquit.o(.data);
        build/src/main/psxsdk/libsnd/scssattr.o(.data);
        build/src/main/psxsdk/libsnd/scsmvol.o(.data);
        build/src/main/psxsdk/libsnd/ssstart.o(.data);
        build/src/main/psxsdk/libsnd/sscall.o(.data);
        build/src/main/psxsdk/libsnd/cres.o(.data);
        build/src/main/psxsdk/libsnd/pause.o(.data);
        build/src/main/psxsdk/libsnd/play.o(.data);
        build/src/main/psxsdk/libsnd/75174.o(.data);
        build/src/main/psxsdk/libsnd/miditime.o(.data);
        build/src/main/psxsdk/libsnd/next.o(.data);
        build/src/main/psxsdk/libsnd/replay.o(.data);
        build/src/main/psxsdk/libsnd/stop.o(.data);
        build/src/main/psxsdk/libsnd/scssvol.o(.data);
        build/src/main/psxsdk/libsnd/sstick.o(.data);
        build/src/main/psxsdk/libsnd/tempo.o(.data);
        build/src/main/psxsdk/libsnd/760D0.o(.data);
        build/src/main/psxsdk/libsnd/ut_gvba.o(.data);
        build/src/main/psxsdk/libsnd/76240.o(.data);
        build/src/main/psxsdk/libsnd/ut_rdep.o(.data);
        build/src/main/psxsdk/libsnd/ut_rev.o(.data);
        build/src/main/psxsdk/libsnd/ut_roff.o(.data);
        build/src/main/psxsdk/libsnd/ut_ron.o(.data);
        build/src/main/psxsdk/libsnd/ut_vvol.o(.data);
        build/src/main/psxsdk/libsnd/vm_doff.o(.data);
        build/src/main/psxsdk/libsnd/vm_f.o(.data);
        build/src/main/psxsdk/libsnd/vm_n2p.o(.data);
        build/src/main/psxsdk/libsnd/774F8.o(.data);
        build/src/main/psxsdk/libsnd/vm_vsu.o(.data);
        build/src/main/psxsdk/libsnd/vs_auto.o(.data);
        build/src/main/psxsdk/libsnd/vs_mono.o(.data);
        build/src/main/psxsdk/libsnd/vs_srv.o(.data);
        build/src/main/psxsdk/libsnd/vs_vab.o(.data);
        build/src/main/psxsdk/libsnd/vs_vfb.o(.data);
        build/src/main/psxsdk/libsnd/vs_vh.o(.data);
        build/src/main/psxsdk/libsnd/vs_vtb.o(.data);
        build/src/main/psxsdk/libsnd/vs_vtc.o(.data);
        build/src/main/psxsdk/libspu/s_i.o(.data);
        build/src/main/psxsdk/libspu/s_ini.o(.data);
        build/src/main/psxsdk/libspu/spu.o(.data);
        build/src/main/psxsdk/libspu/s_dcb.o(.data);
        build/src/main/psxsdk/libspu/s_q.o(.data);
        build/src/main/psxsdk/libapi/a13.o(.data);
        build/src/main/psxsdk/libspu/s_m_init.o(.data);
        build/src/main/psxsdk/libspu/s_m_m.o(.data);
        build/src/main/psxsdk/libspu/s_m_int.o(.data);
        build/src/main/psxsdk/libspu/s_m_f.o(.data);
        build/src/main/psxsdk/libspu/s_snv.o(.data);
        build/src/main/psxsdk/libspu/7A248.o(.data);
        build/src/main/psxsdk/libspu/s_snc.o(.data);
        build/src/main/psxsdk/libspu/s_sr.o(.data);
        build/src/main/psxsdk/libspu/s_m_util.o(.data);
        build/src/main/psxsdk/libspu/s_srmp.o(.data);
        build/src/main/psxsdk/libspu/s_sra.o(.data);
        build/src/main/psxsdk/libspu/s_srv.o(.data);
        build/src/main/psxsdk/libspu/s_crwa.o(.data);
        build/src/main/psxsdk/libapi/a10.o(.data);
        build/src/main/psxsdk/libspu/s_sk.o(.data);
        build/src/main/psxsdk/libspu/s_gks.o(.data);
        build/src/main/psxsdk/libspu/s_r.o(.data);
        build/src/main/psxsdk/libspu/s_w.o(.data);
        build/src/main/psxsdk/libspu/s_stsa.o(.data);
        build/src/main/psxsdk/libspu/s_stm.o(.data);
        build/src/main/psxsdk/libspu/s_itc.o(.data);
        build/src/main/psxsdk/libspu/s_it.o(.data);
        build/src/main/psxsdk/libspu/s_sca.o(.data);
        build/src/main/psxsdk/libspu/sr_gaks.o(.data);
        build/src/main/psxsdk/libspu/7BC88.o(.data);
        build/src/main/psxsdk/libspu/s_n2p.o(.data);
        build/src/main/psxsdk/libspu/s_gvv.o(.data);
        build/src/main/psxsdk/libspu/s_gvex.o(.data);
        build/src/main/psxsdk/libcomb/comb.o(.data);
        build/src/main/psxsdk/libapi/a71.o(.data);
        build/src/main/psxsdk/libapi/a72.o(.data);
        build/src/main/d_7D870.o(.data);
        build/asm/data/91C98.data.o(.data);
        build/src/main/6CF8.o(.sdata);
        build/asm/data/938EA.data.o(.data);
        build/src/main/9F9C.o(.sdata);
        build/asm/data/938FE.data.o(.data);
        build/src/main/17AFC.o(.sdata);
        build/asm/data/93950.data.o(.data);
        build/src/main/24F08.o(.sdata);
        build/asm/data/93978.data.o(.data);
        build/src/main/25C38.o(.sdata);
        build/asm/data/939DC.data.o(.data);
        build/src/main/267A8.o(.sdata);
        build/asm/data/939E6.data.o(.data);
        build/src/main/28514.o(.sdata);
        build/src/main/28708.o(.sdata);
        build/asm/data/93A0E.data.o(.data);
        build/src/main/2B344.o(.sdata);
        build/src/main/309CC.o(.sdata);
        build/src/main/31D3C.o(.sdata);
        build/asm/data/93A3E.data.o(.data);
        build/src/main/35000.o(.sdata);
        build/src/main/368E4.o(.sdata);
        build/src/main/3AB48.o(.sdata);
        build/src/main/51268.o(.sdata);
        build/asm/data/93AC0.data.o(.data);
        build/src/main/5ED34.o(.sdata);
        build/asm/data/93AEA.data.o(.data);
        build/src/main/64FD8.o(.sdata);
        build/asm/data/93B08.data.o(.data);
        build/src/main/9F9C.o(.sbss);
        build/asm/data/93B12.data.o(.data);
        build/src/main/28708.o(.sbss);
        build/asm/data/93B56.data.o(.data);
        build/src/main/2B344.o(.sbss);
        build/src/main/309CC.o(.sbss);
        build/asm/data/93B7C.data.o(.data);
        build/src/main/31D3C.o(.sbss);
        build/asm/data/93B8C.data.o(.data);
        build/src/main/35000.o(.sbss);
        build/src/main/368E4.o(.sbss);
        build/src/main/3AB48.o(.sbss);
        build/asm/data/93C1C.data.o(.data);
        build/src/main/51268.o(.sbss);
        build/asm/data/93D30.data.o(.data);
        build/src/main/5ED34.o(.sbss);
        build/asm/data/93DCC.data.o(.data);
        build/src/main/64FD8.o(.sbss);
        build/asm/data/93E18.data.o(.data);
        main_DATA_END = .;
        main_DATA_SIZE = ABSOLUTE(main_DATA_END - main_DATA_START);
        main_BSS_START = .;
        build/src/main/87A0.o(.bss);
        build/src/main/9F9C.o(.bss);
        build/src/main/175A4.o(.bss);
        build/src/main/17AFC.o(.bss);
        build/src/main/24BF0.o(.bss);
        build/src/main/24F08.o(.bss);
        build/src/main/25788.o(.bss);
        build/src/main/25C38.o(.bss);
        build/src/main/26730.o(.bss);
        build/src/main/267A8.o(.bss);
        build/src/main/26940.o(.bss);
        build/src/main/cdrom.o(.bss);
        build/src/main/memcard.o(.bss);
        build/src/main/28514.o(.bss);
        build/src/main/28708.o(.bss);
        build/src/main/2B344.o(.bss);
        build/src/main/309CC.o(.bss);
        build/src/main/31548.o(.bss);
        build/src/main/31CFC.o(.bss);
        build/src/main/31D3C.o(.bss);
        build/src/main/32D04.o(.bss);
        build/src/main/35000.o(.bss);
        build/src/main/368E4.o(.bss);
        build/src/main/3AB48.o(.bss);
        build/src/main/51268.o(.bss);
        build/src/main/5ED34.o(.bss);
        build/src/main/63D2C.o(.bss);
        build/src/main/64FD8.o(.bss);
        build/src/main/psxsdk/libapi/c67.o(.bss);
        build/src/main/psxsdk/libapi/c112.o(.bss);
        build/src/main/psxsdk/libapi/c159.o(.bss);
        build/src/main/psxsdk/libapi/a08.o(.bss);
        build/src/main/psxsdk/libapi/a09.o(.bss);
        build/src/main/psxsdk/libapi/a11.o(.bss);
        build/src/main/psxsdk/libapi/a12.o(.bss);
        build/src/main/psxsdk/libapi/a36.o(.bss);
        build/src/main/psxsdk/libapi/a37.o(.bss);
        build/src/main/psxsdk/libapi/a39.o(.bss);
        build/src/main/psxsdk/libapi/a50.o(.bss);
        build/src/main/psxsdk/libapi/a52.o(.bss);
        build/src/main/psxsdk/libapi/a53.o(.bss);
        build/src/main/psxsdk/libapi/a54.o(.bss);
        build/src/main/psxsdk/libapi/a65.o(.bss);
        build/src/main/psxsdk/libapi/a66.o(.bss);
        build/src/main/psxsdk/libapi/a67.o(.bss);
        build/src/main/psxsdk/libapi/a91.o(.bss);
        build/src/main/psxsdk/libapi/counter.o(.bss);
        build/src/main/psxsdk/libapi/pad.o(.bss);
        build/src/main/psxsdk/libapi/a18.o(.bss);
        build/src/main/psxsdk/libapi/a19.o(.bss);
        build/src/main/psxsdk/libapi/a20.o(.bss);
        build/src/main/psxsdk/libapi/a21.o(.bss);
        build/src/main/psxsdk/libapi/l02.o(.bss);
        build/src/main/psxsdk/libapi/l03.o(.bss);
        build/src/main/psxsdk/libapi/patch.o(.bss);
        build/src/main/psxsdk/libapi/c68.o(.bss);
        build/src/main/psxsdk/libapi/sendpad.o(.bss);
        build/src/main/psxsdk/libapi/chclrpad.o(.bss);
        build/src/main/psxsdk/libc2/memcpy.o(.bss);
        build/src/main/psxsdk/libc2/rand.o(.bss);
        build/src/main/psxsdk/libc2/strcpy.o(.bss);
        build/src/main/psxsdk/libc2/strlen.o(.bss);
        build/src/main/psxsdk/libc2/printf.o(.bss);
        build/src/main/psxsdk/libc2/prnt.o(.bss);
        build/src/main/psxsdk/libc2/ctype.o(.bss);
        build/src/main/psxsdk/libc2/memchr.o(.bss);
        build/src/main/psxsdk/libc2/putchar.o(.bss);
        build/src/main/psxsdk/libc2/sprintf.o(.bss);
        build/src/main/psxsdk/libc2/memmove.o(.bss);
        build/src/main/psxsdk/libcard/c171.o(.bss);
        build/src/main/psxsdk/libcard/c172.o(.bss);
        build/src/main/psxsdk/libcard/card.o(.bss);
        build/src/main/psxsdk/libcard/a78.o(.bss);
        build/src/main/psxsdk/libcard/a80.o(.bss);
        build/src/main/psxsdk/libcard/init.o(.bss);
        build/src/main/psxsdk/libcard/a74.o(.bss);
        build/src/main/psxsdk/libcard/a75.o(.bss);
        build/src/main/psxsdk/libcard/a76.o(.bss);
        build/src/main/psxsdk/libcard/end.o(.bss);
        build/src/main/psxsdk/libgpu/ext.o(.bss);
        build/src/main/psxsdk/libgpu/prim.o(.bss);
        build/src/main/psxsdk/libgpu/sys.o(.bss);
        build/src/main/psxsdk/libapi/c73.o(.bss);
        build/src/main/psxsdk/libgte/geo_00.o(.bss);
        build/src/main/psxsdk/libgte/geo_01.o(.bss);
        build/src/main/psxsdk/libgte/msc00.o(.bss);
        build/src/main/psxsdk/libgte/msc01.o(.bss);
        build/src/main/psxsdk/libgte/msc06.o(.bss);
        build/src/main/psxsdk/libgte/msc09.o(.bss);
        build/src/main/psxsdk/libgte/mtx_000.o(.bss);
        build/src/main/psxsdk/libgte/mtx_003.o(.bss);
        build/src/main/psxsdk/libgte/mtx_004.o(.bss);
        build/src/main/psxsdk/libgte/mtx_005.o(.bss);
        build/src/main/psxsdk/libgte/mtx_00a.o(.bss);
        build/src/main/psxsdk/libgte/mtx_01.o(.bss);
        build/src/main/psxsdk/libgte/mtx_03.o(.bss);
        build/src/main/psxsdk/libgte/mtx_04.o(.bss);
        build/src/main/psxsdk/libgte/mtx_05.o(.bss);
        build/src/main/psxsdk/libgte/mtx_08.o(.bss);
        build/src/main/psxsdk/libgte/mtx_09.o(.bss);
        build/src/main/psxsdk/libgte/mtx_11.o(.bss);
        build/src/main/psxsdk/libgte/mtx_12.o(.bss);
        build/src/main/psxsdk/libgte/reg04.o(.bss);
        build/src/main/psxsdk/libgte/reg09.o(.bss);
        build/src/main/psxsdk/libgte/reg10.o(.bss);
        build/src/main/psxsdk/libgte/reg11.o(.bss);
        build/src/main/psxsdk/libgte/reg12.o(.bss);
        build/src/main/psxsdk/libgte/reg13.o(.bss);
        build/src/main/psxsdk/libgte/smp_00.o(.bss);
        build/src/main/psxsdk/libgte/smp_02.o(.bss);
        build/src/main/psxsdk/libgte/smp_03.o(.bss);
        build/src/main/psxsdk/libgte/smp_04.o(.bss);
        build/src/main/psxsdk/libgte/cmb_00.o(.bss);
        build/src/main/psxsdk/libgte/fgo_01.o(.bss);
        build/src/main/psxsdk/libgte/fgo_03.o(.bss);
        build/src/main/psxsdk/libgte/fgo_04.o(.bss);
        build/src/main/psxsdk/libgte/fgo_05.o(.bss);
        build/src/main/psxsdk/libgte/fgo_06.o(.bss);
        build/src/main/psxsdk/libgte/ratan.o(.bss);
        build/src/main/psxsdk/libgte/patchgte.o(.bss);
        build/src/main/psxsdk/libcd/event.o(.bss);
        build/src/main/psxsdk/libapi/a07.o(.bss);
        build/src/main/psxsdk/libcd/sys.o(.bss);
        build/src/main/psxsdk/libcd/bios.o(.bss);
        build/src/main/psxsdk/libc2/puts.o(.bss);
        build/src/main/psxsdk/libcd/cdread.o(.bss);
        build/src/main/psxsdk/libetc/vsync.o(.bss);
        build/src/main/psxsdk/libapi/l10.o(.bss);
        build/src/main/psxsdk/libetc/intr.o(.bss);
        build/src/main/psxsdk/libapi/c114.o(.bss);
        build/src/main/psxsdk/libapi/a23.o(.bss);
        build/src/main/psxsdk/libapi/a24.o(.bss);
        build/src/main/psxsdk/libapi/a25.o(.bss);
        build/src/main/psxsdk/libc2/setjmp.o(.bss);
        build/src/main/psxsdk/libetc/intr_vb.o(.bss);
        build/src/main/psxsdk/libetc/intr_dma.o(.bss);
        build/src/main/psxsdk/libetc/vmode.o(.bss);
        build/src/main/psxsdk/libsn/73E98.o(.bss);
        build/src/main/psxsdk/libapi/c57.o(.bss);
        build/src/main/psxsdk/libsn/7407C.o(.bss);
        build/src/main/psxsdk/libsnd/ssend.o(.bss);
        build/src/main/psxsdk/libsnd/ssinit_c.o(.bss);
        build/src/main/psxsdk/libsnd/ssinit.o(.bss);
        build/src/main/psxsdk/libsnd/ssquit.o(.bss);
        build/src/main/psxsdk/libsnd/scssattr.o(.bss);
        build/src/main/psxsdk/libsnd/scsmvol.o(.bss);
        build/src/main/psxsdk/libsnd/ssstart.o(.bss);
        build/src/main/psxsdk/libsnd/sscall.o(.bss);
        build/src/main/psxsdk/libsnd/cres.o(.bss);
        build/src/main/psxsdk/libsnd/pause.o(.bss);
        build/src/main/psxsdk/libsnd/play.o(.bss);
        build/src/main/psxsdk/libsnd/75174.o(.bss);
        build/src/main/psxsdk/libsnd/miditime.o(.bss);
        build/src/main/psxsdk/libsnd/next.o(.bss);
        build/src/main/psxsdk/libsnd/replay.o(.bss);
        build/src/main/psxsdk/libsnd/stop.o(.bss);
        build/src/main/psxsdk/libsnd/scssvol.o(.bss);
        build/src/main/psxsdk/libsnd/sstick.o(.bss);
        build/src/main/psxsdk/libsnd/tempo.o(.bss);
        build/src/main/psxsdk/libsnd/760D0.o(.bss);
        build/src/main/psxsdk/libsnd/ut_gvba.o(.bss);
        build/src/main/psxsdk/libsnd/76240.o(.bss);
        build/src/main/psxsdk/libsnd/ut_rdep.o(.bss);
        build/src/main/psxsdk/libsnd/ut_rev.o(.bss);
        build/src/main/psxsdk/libsnd/ut_roff.o(.bss);
        build/src/main/psxsdk/libsnd/ut_ron.o(.bss);
        build/src/main/psxsdk/libsnd/ut_vvol.o(.bss);
        build/src/main/psxsdk/libsnd/vm_doff.o(.bss);
        build/src/main/psxsdk/libsnd/vm_f.o(.bss);
        build/src/main/psxsdk/libsnd/vm_n2p.o(.bss);
        build/src/main/psxsdk/libsnd/774F8.o(.bss);
        build/src/main/psxsdk/libsnd/vm_vsu.o(.bss);
        build/src/main/psxsdk/libsnd/vs_auto.o(.bss);
        build/src/main/psxsdk/libsnd/vs_mono.o(.bss);
        build/src/main/psxsdk/libsnd/vs_srv.o(.bss);
        build/src/main/psxsdk/libsnd/vs_vab.o(.bss);
        build/src/main/psxsdk/libsnd/vs_vfb.o(.bss);
        build/src/main/psxsdk/libsnd/vs_vh.o(.bss);
        build/src/main/psxsdk/libsnd/vs_vtb.o(.bss);
        build/src/main/psxsdk/libsnd/vs_vtc.o(.bss);
        build/src/main/psxsdk/libspu/s_i.o(.bss);
        build/src/main/psxsdk/libspu/s_ini.o(.bss);
        build/src/main/psxsdk/libspu/spu.o(.bss);
        build/src/main/psxsdk/libspu/s_dcb.o(.bss);
        build/src/main/psxsdk/libspu/s_q.o(.bss);
        build/src/main/psxsdk/libapi/a13.o(.bss);
        build/src/main/psxsdk/libspu/s_m_init.o(.bss);
        build/src/main/psxsdk/libspu/s_m_m.o(.bss);
        build/src/main/psxsdk/libspu/s_m_int.o(.bss);
        build/src/main/psxsdk/libspu/s_m_f.o(.bss);
        build/src/main/psxsdk/libspu/s_snv.o(.bss);
        build/src/main/psxsdk/libspu/7A248.o(.bss);
        build/src/main/psxsdk/libspu/s_snc.o(.bss);
        build/src/main/psxsdk/libspu/s_sr.o(.bss);
        build/src/main/psxsdk/libspu/s_m_util.o(.bss);
        build/src/main/psxsdk/libspu/s_srmp.o(.bss);
        build/src/main/psxsdk/libspu/s_sra.o(.bss);
        build/src/main/psxsdk/libspu/s_srv.o(.bss);
        build/src/main/psxsdk/libspu/s_crwa.o(.bss);
        build/src/main/psxsdk/libapi/a10.o(.bss);
        build/src/main/psxsdk/libspu/s_sk.o(.bss);
        build/src/main/psxsdk/libspu/s_gks.o(.bss);
        build/src/main/psxsdk/libspu/s_r.o(.bss);
        build/src/main/psxsdk/libspu/s_w.o(.bss);
        build/src/main/psxsdk/libspu/s_stsa.o(.bss);
        build/src/main/psxsdk/libspu/s_stm.o(.bss);
        build/src/main/psxsdk/libspu/s_itc.o(.bss);
        build/src/main/psxsdk/libspu/s_it.o(.bss);
        build/src/main/psxsdk/libspu/s_sca.o(.bss);
        build/src/main/psxsdk/libspu/sr_gaks.o(.bss);
        build/src/main/psxsdk/libspu/7BC88.o(.bss);
        build/src/main/psxsdk/libspu/s_n2p.o(.bss);
        build/src/main/psxsdk/libspu/s_gvv.o(.bss);
        build/src/main/psxsdk/libspu/s_gvex.o(.bss);
        build/src/main/psxsdk/libcomb/comb.o(.bss);
        build/src/main/psxsdk/libapi/a71.o(.bss);
        build/src/main/psxsdk/libapi/a72.o(.bss);
        build/src/main/d_7D870.o(.bss);
        main_BSS_END = .;
        main_BSS_SIZE = ABSOLUTE(main_BSS_END - main_BSS_START);
    }
    __romPos += SIZEOF(.main);
    __romPos = ALIGN(__romPos, 16);
    . = ALIGN(., 16);
    main_ROM_END = __romPos;
    main_VRAM_END = .;

    /DISCARD/ :
    {
        *(*);
    }
}
