SECTIONS
{
    __romPos = 0;
    _gp = 0x801F65D0;
    header_ROM_START = __romPos;
    header_VRAM = ADDR(.header);
    .header : AT(header_ROM_START) SUBALIGN(2)
    {
        FILL(0x00000000);
        header_DATA_START = .;
        build/asm/header.o(.data);
        header_DATA_END = .;
        header_DATA_SIZE = ABSOLUTE(header_DATA_END - header_DATA_START);
    }
    __romPos += SIZEOF(.header);
    header_ROM_END = __romPos;
    header_VRAM_END = .;

    movovl_ROM_START = __romPos;
    movovl_VRAM = ADDR(.movovl);
    .movovl 0x801D8800 : AT(movovl_ROM_START) SUBALIGN(2)
    {
        FILL(0x00000000);
        movovl_RODATA_START = .;
        build/asm/data/rodata_800.rodata.o(.rodata);
        build/asm/game.o(.rodata);
        build/asm/libc2_printf.o(.rodata);
        build/asm/libc2_prnt.o(.rodata);
        build/asm/libc2_ctype.o(.rodata);
        build/asm/libc2_memchr.o(.rodata);
        build/asm/libc2_putchar.o(.rodata);
        build/asm/libapi_a53.o(.rodata);
        build/asm/libc2_strlen.o(.rodata);
        build/asm/libpress_libpress.o(.rodata);
        build/asm/libpress_vlc.o(.rodata);
        build/asm/libgpu_ext.o(.rodata);
        build/asm/libgpu_prim.o(.rodata);
        build/asm/libgpu_sys.o(.rodata);
        build/asm/libapi_c73.o(.rodata);
        build/asm/libc2_memcpy.o(.rodata);
        build/asm/libcd_cdrom.o(.rodata);
        build/asm/libcd_event.o(.rodata);
        build/asm/libapi_a07.o(.rodata);
        build/asm/libcd_sys.o(.rodata);
        build/asm/libcd_bios.o(.rodata);
        build/asm/libc2_puts.o(.rodata);
        build/asm/libcd_cdread.o(.rodata);
        build/asm/libcd_cdread2.o(.rodata);
        build/asm/libcd_c_002.o(.rodata);
        build/asm/libcd_c_003.o(.rodata);
        build/asm/libapi_a36.o(.rodata);
        build/asm/libapi_a37.o(.rodata);
        build/asm/libcd_c_004.o(.rodata);
        build/asm/libcd_c_005.o(.rodata);
        build/asm/libcd_c_007.o(.rodata);
        build/asm/libcd_c_008.o(.rodata);
        build/asm/libcd_c_009.o(.rodata);
        build/asm/libcd_c_010.o(.rodata);
        build/asm/libcd_c_011.o(.rodata);
        build/asm/libetc_pad.o(.rodata);
        build/asm/libapi_a22.o(.rodata);
        build/asm/libapi_a91.o(.rodata);
        build/asm/libapi_pad.o(.rodata);
        build/asm/libapi_a18.o(.rodata);
        build/asm/libapi_a19.o(.rodata);
        build/asm/libapi_a20.o(.rodata);
        build/asm/libapi_a21.o(.rodata);
        build/asm/libapi_l02.o(.rodata);
        build/asm/libapi_l03.o(.rodata);
        build/asm/libapi_patch.o(.rodata);
        build/asm/libapi_c68.o(.rodata);
        build/asm/libapi_sendpad.o(.rodata);
        build/asm/libapi_chclrpad.o(.rodata);
        build/asm/libetc_vsync.o(.rodata);
        build/asm/libapi_l10.o(.rodata);
        build/asm/libetc_intr.o(.rodata);
        build/asm/libapi_c114.o(.rodata);
        build/asm/libapi_a23.o(.rodata);
        build/asm/libapi_a24.o(.rodata);
        build/asm/libapi_a25.o(.rodata);
        build/asm/libc2_setjmp.o(.rodata);
        build/asm/libetc_intr_vb.o(.rodata);
        build/asm/libetc_intr_dma.o(.rodata);
        build/asm/libetc_vmode.o(.rodata);
        build/asm/libds_dscb.o(.rodata);
        . = ALIGN(., 16);
        movovl_RODATA_END = .;
        movovl_RODATA_SIZE = ABSOLUTE(movovl_RODATA_END - movovl_RODATA_START);
        movovl_TEXT_START = .;
        build/asm/game.o(.text);
        build/asm/libc2_printf.o(.text);
        build/asm/libc2_prnt.o(.text);
        build/asm/libc2_ctype.o(.text);
        build/asm/libc2_memchr.o(.text);
        build/asm/libc2_putchar.o(.text);
        build/asm/libapi_a53.o(.text);
        build/asm/libc2_strlen.o(.text);
        build/asm/libpress_libpress.o(.text);
        build/asm/libpress_vlc.o(.text);
        build/asm/libgpu_ext.o(.text);
        build/asm/libgpu_prim.o(.text);
        build/asm/libgpu_sys.o(.text);
        build/asm/libapi_c73.o(.text);
        build/asm/libc2_memcpy.o(.text);
        build/asm/libcd_cdrom.o(.text);
        build/asm/libcd_event.o(.text);
        build/asm/libapi_a07.o(.text);
        build/asm/libcd_sys.o(.text);
        build/asm/libcd_bios.o(.text);
        build/asm/libc2_puts.o(.text);
        build/asm/libcd_cdread.o(.text);
        build/asm/libcd_cdread2.o(.text);
        build/asm/libcd_c_002.o(.text);
        build/asm/libcd_c_003.o(.text);
        build/asm/libapi_a36.o(.text);
        build/asm/libapi_a37.o(.text);
        build/asm/libcd_c_004.o(.text);
        build/asm/libcd_c_005.o(.text);
        build/asm/libcd_c_007.o(.text);
        build/asm/libcd_c_008.o(.text);
        build/asm/libcd_c_009.o(.text);
        build/asm/libcd_c_010.o(.text);
        build/asm/libcd_c_011.o(.text);
        build/asm/libetc_pad.o(.text);
        build/asm/libapi_a22.o(.text);
        build/asm/libapi_a91.o(.text);
        build/asm/libapi_pad.o(.text);
        build/asm/libapi_a18.o(.text);
        build/asm/libapi_a19.o(.text);
        build/asm/libapi_a20.o(.text);
        build/asm/libapi_a21.o(.text);
        build/asm/libapi_l02.o(.text);
        build/asm/libapi_l03.o(.text);
        build/asm/libapi_patch.o(.text);
        build/asm/libapi_c68.o(.text);
        build/asm/libapi_sendpad.o(.text);
        build/asm/libapi_chclrpad.o(.text);
        build/asm/libetc_vsync.o(.text);
        build/asm/libapi_l10.o(.text);
        build/asm/libetc_intr.o(.text);
        build/asm/libapi_c114.o(.text);
        build/asm/libapi_a23.o(.text);
        build/asm/libapi_a24.o(.text);
        build/asm/libapi_a25.o(.text);
        build/asm/libc2_setjmp.o(.text);
        build/asm/libetc_intr_vb.o(.text);
        build/asm/libetc_intr_dma.o(.text);
        build/asm/libetc_vmode.o(.text);
        build/asm/libds_dscb.o(.text);
        . = ALIGN(., 16);
        movovl_TEXT_END = .;
        movovl_TEXT_SIZE = ABSOLUTE(movovl_TEXT_END - movovl_TEXT_START);
        movovl_DATA_START = .;
        build/asm/data/rodata_800.rodata.o(.data);
        build/asm/game.o(.data);
        build/asm/libc2_printf.o(.data);
        build/asm/libc2_prnt.o(.data);
        build/asm/libc2_ctype.o(.data);
        build/asm/libc2_memchr.o(.data);
        build/asm/libc2_putchar.o(.data);
        build/asm/libapi_a53.o(.data);
        build/asm/libc2_strlen.o(.data);
        build/asm/libpress_libpress.o(.data);
        build/asm/libpress_vlc.o(.data);
        build/asm/libgpu_ext.o(.data);
        build/asm/libgpu_prim.o(.data);
        build/asm/libgpu_sys.o(.data);
        build/asm/libapi_c73.o(.data);
        build/asm/libc2_memcpy.o(.data);
        build/asm/libcd_cdrom.o(.data);
        build/asm/libcd_event.o(.data);
        build/asm/libapi_a07.o(.data);
        build/asm/libcd_sys.o(.data);
        build/asm/libcd_bios.o(.data);
        build/asm/libc2_puts.o(.data);
        build/asm/libcd_cdread.o(.data);
        build/asm/libcd_cdread2.o(.data);
        build/asm/libcd_c_002.o(.data);
        build/asm/libcd_c_003.o(.data);
        build/asm/libapi_a36.o(.data);
        build/asm/libapi_a37.o(.data);
        build/asm/libcd_c_004.o(.data);
        build/asm/libcd_c_005.o(.data);
        build/asm/libcd_c_007.o(.data);
        build/asm/libcd_c_008.o(.data);
        build/asm/libcd_c_009.o(.data);
        build/asm/libcd_c_010.o(.data);
        build/asm/libcd_c_011.o(.data);
        build/asm/libetc_pad.o(.data);
        build/asm/libapi_a22.o(.data);
        build/asm/libapi_a91.o(.data);
        build/asm/libapi_pad.o(.data);
        build/asm/libapi_a18.o(.data);
        build/asm/libapi_a19.o(.data);
        build/asm/libapi_a20.o(.data);
        build/asm/libapi_a21.o(.data);
        build/asm/libapi_l02.o(.data);
        build/asm/libapi_l03.o(.data);
        build/asm/libapi_patch.o(.data);
        build/asm/libapi_c68.o(.data);
        build/asm/libapi_sendpad.o(.data);
        build/asm/libapi_chclrpad.o(.data);
        build/asm/libetc_vsync.o(.data);
        build/asm/libapi_l10.o(.data);
        build/asm/libetc_intr.o(.data);
        build/asm/libapi_c114.o(.data);
        build/asm/libapi_a23.o(.data);
        build/asm/libapi_a24.o(.data);
        build/asm/libapi_a25.o(.data);
        build/asm/libc2_setjmp.o(.data);
        build/asm/libetc_intr_vb.o(.data);
        build/asm/libetc_intr_dma.o(.data);
        build/asm/libetc_vmode.o(.data);
        build/asm/libds_dscb.o(.data);
        build/asm/data/data_C268.data.o(.data);
        . = ALIGN(., 16);
        movovl_DATA_END = .;
        movovl_DATA_SIZE = ABSOLUTE(movovl_DATA_END - movovl_DATA_START);
        movovl_BSS_START = .;
        build/asm/data/rodata_800.rodata.o(.bss);
        build/asm/game.o(.bss);
        build/asm/libc2_printf.o(.bss);
        build/asm/libc2_prnt.o(.bss);
        build/asm/libc2_ctype.o(.bss);
        build/asm/libc2_memchr.o(.bss);
        build/asm/libc2_putchar.o(.bss);
        build/asm/libapi_a53.o(.bss);
        build/asm/libc2_strlen.o(.bss);
        build/asm/libpress_libpress.o(.bss);
        build/asm/libpress_vlc.o(.bss);
        build/asm/libgpu_ext.o(.bss);
        build/asm/libgpu_prim.o(.bss);
        build/asm/libgpu_sys.o(.bss);
        build/asm/libapi_c73.o(.bss);
        build/asm/libc2_memcpy.o(.bss);
        build/asm/libcd_cdrom.o(.bss);
        build/asm/libcd_event.o(.bss);
        build/asm/libapi_a07.o(.bss);
        build/asm/libcd_sys.o(.bss);
        build/asm/libcd_bios.o(.bss);
        build/asm/libc2_puts.o(.bss);
        build/asm/libcd_cdread.o(.bss);
        build/asm/libcd_cdread2.o(.bss);
        build/asm/libcd_c_002.o(.bss);
        build/asm/libcd_c_003.o(.bss);
        build/asm/libapi_a36.o(.bss);
        build/asm/libapi_a37.o(.bss);
        build/asm/libcd_c_004.o(.bss);
        build/asm/libcd_c_005.o(.bss);
        build/asm/libcd_c_007.o(.bss);
        build/asm/libcd_c_008.o(.bss);
        build/asm/libcd_c_009.o(.bss);
        build/asm/libcd_c_010.o(.bss);
        build/asm/libcd_c_011.o(.bss);
        build/asm/libetc_pad.o(.bss);
        build/asm/libapi_a22.o(.bss);
        build/asm/libapi_a91.o(.bss);
        build/asm/libapi_pad.o(.bss);
        build/asm/libapi_a18.o(.bss);
        build/asm/libapi_a19.o(.bss);
        build/asm/libapi_a20.o(.bss);
        build/asm/libapi_a21.o(.bss);
        build/asm/libapi_l02.o(.bss);
        build/asm/libapi_l03.o(.bss);
        build/asm/libapi_patch.o(.bss);
        build/asm/libapi_c68.o(.bss);
        build/asm/libapi_sendpad.o(.bss);
        build/asm/libapi_chclrpad.o(.bss);
        build/asm/libetc_vsync.o(.bss);
        build/asm/libapi_l10.o(.bss);
        build/asm/libetc_intr.o(.bss);
        build/asm/libapi_c114.o(.bss);
        build/asm/libapi_a23.o(.bss);
        build/asm/libapi_a24.o(.bss);
        build/asm/libapi_a25.o(.bss);
        build/asm/libc2_setjmp.o(.bss);
        build/asm/libetc_intr_vb.o(.bss);
        build/asm/libetc_intr_dma.o(.bss);
        build/asm/libetc_vmode.o(.bss);
        build/asm/libds_dscb.o(.bss);
        . = ALIGN(., 16);
        movovl_BSS_END = .;
        movovl_BSS_SIZE = ABSOLUTE(movovl_BSS_END - movovl_BSS_START);
    }
    __romPos += SIZEOF(.movovl);
    __romPos = ALIGN(__romPos, 16);
    . = ALIGN(., 16);
    movovl_ROM_END = __romPos;
    movovl_VRAM_END = .;

    /DISCARD/ :
    {
        *(*);
    }
}
